## config/west.yml
```yaml
manifest:
  remotes:
    - name: zmkfirmware
      url-base: https://github.com/zmkfirmware
    - name: SethMilliken
      url-base: https://github.com/SethMilliken
    - name: t-ogura
      url-base: https://github.com/t-ogura
  projects:
    - name: zmk
      remote: zmkfirmware
      revision: main
      import: app/west.yml
    - name: zmk-seth-milliken
      remote: SethMilliken
      repo-path: zmk
      revision: zen-display-patches # custom branch name
      import: app/west.yml
    - name: prospector-zmk-module
      remote: t-ogura
      revision: v2.2.3
      path: modules/prospector-zmk-module
  self:
    path: config
```
